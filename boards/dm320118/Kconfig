## boards/dm320118/Kconfig
```kconfig
# Copyright (c) 2024 Instagrid GmbH
#
# This file is subject to the terms and conditions of the GNU Lesser
# General Public License v2.1. See the file LICENSE in the top level
# directory for more details.

config BOARD
    default "dm320118" if BOARD_DM320118

config BOARD_DM320118
    bool
    default y
    select CPU_MODEL_SAMD21E18A
```
